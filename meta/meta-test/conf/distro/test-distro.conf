## meta/meta-test/conf/distro/test-distro.conf
```bitbake
include conf/distro/poky.conf

DISTRO = "test-distro"
DISTRO_NAME = " test distro with version ${DISTRO_VERSION} "
DISTRO_VERSION = "1.0"
DISTRO_FEATURES:remove = " pcmcia pci ext2 nfc ptest 3g"
INIT_MANAGER = "systemd"
```

## meta/meta-test/conf/machine/test-machine.conf
```bitbake
# To extend the machine name in the local.conf in order to interpret this file as machine file

MACHINEOVERRIDES = "beaglebone-yocto:${MACHINE}"

#To inherit the machine configuration 
require conf/machine/beaglebone-yocto.conf
```
